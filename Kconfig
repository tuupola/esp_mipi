## Kconfig
```kconfig
menu "Display configuration (MIPI)"

menu "Display address mode (orientation + RGB / BGR)"
    config MIPI_DCS_ADDRESS_MODE_MIRROR_Y_SELECTED
        bool "Mirror Y"
    config MIPI_DCS_ADDRESS_MODE_MIRROR_X_SELECTED
        bool "Mirror X"
    config MIPI_DCS_ADDRESS_MODE_SWAP_XY_SELECTED
        bool "Swap X and Y"
    config MIPI_DCS_ADDRESS_MODE_FLIP_X_SELECTED
        bool "Flip X"
    config MIPI_DCS_ADDRESS_MODE_FLIP_Y_SELECTED
        bool "Flip Y"
    config MIPI_DCS_ADDRESS_MODE_BGR_SELECTED
        bool "BGR"
endmenu

config MIPI_DCS_ADDRESS_MODE_MIRROR_Y
    hex
    default 0x00 if !MIPI_DCS_ADDRESS_MODE_MIRROR_Y_SELECTED
    default 0x80 if MIPI_DCS_ADDRESS_MODE_MIRROR_Y_SELECTED

config MIPI_DCS_ADDRESS_MODE_MIRROR_X
    hex
    default 0x00 if !MIPI_DCS_ADDRESS_MODE_MIRROR_X_SELECTED
    default 0x40 if MIPI_DCS_ADDRESS_MODE_MIRROR_X_SELECTED

config MIPI_DCS_ADDRESS_MODE_SWAP_XY
    hex
    default 0x00 if !MIPI_DCS_ADDRESS_MODE_SWAP_XY_SELECTED
    default 0x20 if MIPI_DCS_ADDRESS_MODE_SWAP_XY_SELECTED

config MIPI_DCS_ADDRESS_MODE_FLIP_X
    hex
    default 0x00 if !MIPI_DCS_ADDRESS_MODE_FLIP_X_SELECTED
    default 0x02 if MIPI_DCS_ADDRESS_MODE_FLIP_X_SELECTED

config MIPI_DCS_ADDRESS_MODE_FLIP_Y
    hex
    default 0x00 if !MIPI_DCS_ADDRESS_MODE_FLIP_Y_SELECTED
    default 0x01 if MIPI_DCS_ADDRESS_MODE_FLIP_Y_SELECTED

config MIPI_DCS_ADDRESS_MODE_BGR
    hex
    default 0x00 if !MIPI_DCS_ADDRESS_MODE_BGR_SELECTED
    default 0x08 if MIPI_DCS_ADDRESS_MODE_BGR_SELECTED


config MIPI_DISPLAY_SET_PIXEL_FORMAT
    hex "Pixel "
    default 0x55
    help
        Pixel format for the RGB image data.

config MIPI_DISPLAY_WIDTH
    int "Display width in pixels"
    default 320

config MIPI_DISPLAY_HEIGHT
    int "Display height in pixels"
    default 240

config MIPI_DISPLAY_OFFSET_X
    int "X offset"
    default 0
    help
        Adjust when using small display and image is not centered.

config MIPI_DISPLAY_OFFSET_Y
    int "Y offset"
    default 0
    help
        Adjust when using small display and image is not centered.

config MIPI_DISPLAY_INVERT
    bool "Invert colors"

config SPI_CLOCK_SPEED_HZ
    int "SPI clock speed in Hz"
    default 48000000
    range 0 60000000
    help
        SPI clock speed in Hz. If you have problems try a lower value.

config MIPI_DISPLAY_PIN_MISO
    int "MISO pin number"
    default -1

config MIPI_DISPLAY_PIN_MOSI
    int "MOSI pin number"
    default 23

config MIPI_DISPLAY_PIN_CLK
    int "CLK pin number"
    default 18

config MIPI_DISPLAY_PIN_CS
    int "CS pin number"
    default 14

config MIPI_DISPLAY_PIN_DC
    int "DC pin number"
    default 27

config MIPI_DISPLAY_PIN_RST
    int "RST pin number"
    default 33
    help
        RST pin number. Defaults are ok for M5Stick.

config MIPI_DISPLAY_PIN_BL
    int "Backlight pin number"
    default 32

endmenu
```
